#include <Wire.h>
#include <Adafruit_MCP4725.h>
#include <math.h>

#define DAC_ADDRESS 0x62 // MCP4725 I2C address

Adafruit_MCP4725 dac;

#define T_MIN 461.25
#define T_MAX 153.75
const double OMEGA_T_MIN = sin(1626.01626 * T_MIN + (2*PI));
const double OMEGA_T_MAX = sin(1626.01626 * T_MAX + (2*PI));

const uint16_t lookup[] =
{
1192,
1154,
1180,
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1194,
};

void setup() {
  Wire.begin();
  dac.begin(DAC_ADDRESS);
  dac.setVoltage(0, false); // set initial DAC output to 0V
  Serial.begin(9600);
  delay(25);

    // for (int i = 0; i < 616; i++){
    //   dac.setVoltage(lookup[i], false);
    //   delayMicroseconds(1000);
    // }
}

double generate_sinx(int scanTo, int level, double thetaT, double thetaR, double thetaBW){
    double x;
    double sinXoX;

    if (scanTo && level){
        x = PI * (((thetaT + (T_MAX/50.0)) - thetaR)/(1.15 * thetaBW));
    }
    else if (scanTo && !level){
        x = PI * (((thetaT + (T_MIN/50.0)) - thetaR)/(1.15 * thetaBW));
    }
    else if (!scanTo && level){
        x = PI * (((thetaT - (T_MAX/50.0)) - thetaR)/(1.15 * thetaBW));
    }
    else{
        x = PI * (((thetaT - (T_MIN/50.0)) - thetaR)/(1.15 * thetaBW));
    }

    sinXoX = sin(x)/x;
    return sinXoX;
}

double generate_wave(int scanTo, int t, double thetaT, double thetaR, double thetaBW){
    double x;
    double sinXoX;
    double wave;

    if(scanTo){
        x = PI * (((thetaT + (t/50.0)) - thetaR)/(1.15 * thetaBW));
    }
    else{
        x = PI * (((thetaT - (t/50.0)) - thetaR)/(1.15 * thetaBW));
    }

    sinXoX = sin(x)/x;
    wave = sinXoX * sin(1626.01626 * t + (2*PI));
    return wave;
}

void loop(){
    // double wave;
    // long waveLong;
    // int mappedWave;
    // double sinXoXMax = generate_sinx(1, 1, -1.082, -0.1745, 0.034);
    // double sinXoXMin = generate_sinx(1, 0, -1.082, -0.1745, 0.034);

    // for (int i = 0; i < 616; i++){
    //     //wave = generate_wave(1, i, -1.082, -0.1745, 0.034);
    //     //waveLong = wave * pow(10, 5);
    //     //mappedWave = map(waveLong, -0.342*pow(10, 5), 0.832*pow(10, 5), 0, 4095);
    //     dac.setVoltage(lookup[i], false);
    //     //delayMicroseconds(1000);
    // }
    for (int i = 0; i < 616; i++){
      dac.setVoltage(lookup[i], false);
      delayMicroseconds(2);
    }
}